## layers/meta-mouadh-os-distro/conf/distro/mouadh-os.conf
```bitbake
DISTRO = "mouadh-os"
DISTRO_NAME = "mouadh-os Reference Distribution"
DISTRO_VERSION = "1.0"

# In order to use one tmp dir
TCLIBCAPPEND = ""
TCLIBC = "glibc"

INIT_MANAGER = "systemd"

# Minimize GPLv3 packages
require conf/distro/include/no-gplv3.inc

# Enhace serurity options for CFLAGS/LDFLAGS
require conf/distro/include/security_flags.inc

DISTRO_FEATURES = " \
    acl \
    bluetooth \
    ext2 \
    ipv4 \
    ipv6 \
    pcmcia \
    usbgadget \
    usbhost \
    wifi \
    xattr \
    zeroconf \
    pci \
    3g \
    vfat \
    seccomp \
    systemd \
    usrmerge \
"
```
